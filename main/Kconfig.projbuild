## main/Kconfig.projbuild
```kconfig
menu "Multiple LCD Example Configuration"

    config I2C_NUM
        int "I2C peripheral index"
        range 0 1
        default 0
        help
            Select I2C peripheral number.

	menu "Time Configuration"
		config SNTP_TIME_SERVER
			string "SNTP server name"
			default "pool.ntp.org"
			help
				Hostname of the main SNTP server.

		config TIME_ZONE
			string "Time zone TZ string"
			default "CET-1CEST,M3.5.0,M10.5.0/3"
			help
				Time zone string from https://github.com/nayarsystems/posix_tz_db/blob/master/zones.csv

		choice SNTP_TIME_SYNC_METHOD
			prompt "Time synchronization method"
			default SNTP_TIME_SYNC_METHOD_IMMED
			help
				Time synchronization method.

			config SNTP_TIME_SYNC_METHOD_IMMED
				bool "update time immediately when received"
			config SNTP_TIME_SYNC_METHOD_SMOOTH
				bool "update time with smooth method (adjtime)"
			config SNTP_TIME_SYNC_METHOD_CUSTOM
				bool "custom implementation"
		endchoice
	endmenu

    menu "Weather Configuration"
        config WEATHER_UPDATE_MIN
            int "Update period in minutes"
            default 10

        config WEATHER_API_KEY
            string "OpenWeatherMap API Key"

	endmenu

endmenu
```

## sdkconfig.defaults
```kconfig
CONFIG_IDF_TARGET="esp32s3"
CONFIG_ESP32S2_DEFAULT_CPU_FREQ_240=y
CONFIG_PARTITION_TABLE_CUSTOM=y
CONFIG_ESPTOOLPY_FLASHSIZE_4MB=y
CONFIG_PARTITION_TABLE_CUSTOM_FILENAME=partitions.csv
CONFIG_LV_COLOR_16_SWAP=y
CONFIG_LV_MEM_CUSTOM=y
CONFIG_LV_MEMCPY_MEMSET_STD=y
CONFIG_LV_USE_USER_DATA=y
CONFIG_LV_FONT_MONTSERRAT_20=y
CONFIG_LV_FONT_MONTSERRAT_22=y
CONFIG_LV_FONT_MONTSERRAT_30=y
CONFIG_LV_FONT_MONTSERRAT_40=y
CONFIG_LV_FONT_UNSCII_8=y
CONFIG_LV_FONT_UNSCII_16=y
CONFIG_LV_COLOR_DEPTH_16=y
CONFIG_LV_USE_TABVIEW=y
CONFIG_LV_USE_SPINBOX=y
CONFIG_LV_USE_KEYBOARD=y
CONFIG_LV_USE_LIST=y
CONFIG_LV_SPRINTF_USE_FLOAT=y

CONFIG_FREERTOS_HZ=1000
```
